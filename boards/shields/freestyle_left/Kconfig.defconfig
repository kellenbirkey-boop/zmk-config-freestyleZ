## boards/shields/freestyle_left/Kconfig.defconfig
```kconfig
if SHIELD_FREESTYLE_LEFT

config ZMK_KEYBOARD_NAME
    default "Freestyle Left"

endif
```

## boards/shields/freestyle_left/Kconfig.shield
```kconfig
config SHIELD_FREESTYLE_LEFT
    def_bool $(shields_list_contains,freestyle_left)
```
